## config/west.yml
```yaml
manifest:
  remotes:
      # zmk
    - name: zmkfirmware
      url-base: https://github.com/zmkfirmware
      # zmk-helpers
    - name: urob
      url-base: https://github.com/urob
      # zmk-nice-oled
    # - name: mctechnology17
    #   url-base: https://github.com/mctechnology17
  projects:
      # zmk - the main firmware
    - name: zmk
      remote: zmkfirmware
      revision: main
      import: app/west.yml
      # zmk helpers - for language stuff
    - name: zmk-helpers
      remote: urob
      revision: main
      # zmk-nice-oled - for OLED display
    # - name: zmk-nice-oled
    #   remote: mctechnology17
    #   revision: main
  self:
    path: config

    # Additional modules containing boards/shields/custom code can be listed here as well
    # See https://docs.zephyrproject.org/3.2.0/develop/west/manifest.html#projects
```
